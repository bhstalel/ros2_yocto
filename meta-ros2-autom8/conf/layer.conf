## meta-ros2-autom8/conf/layer.conf
```bitbake
# We have a conf and classes directory, add to BBPATH
BBPATH .= ":${LAYERDIR}"

# We have recipes-* directories, add to BBFILES
BBFILES += "${LAYERDIR}/recipes-*/*/*.bb \
            ${LAYERDIR}/recipes-*/*/*.bbappend"

BBFILE_COLLECTIONS += "meta-ros2-autom8"
BBFILE_PATTERN_meta-ros2-autom8 = "^${LAYERDIR}/"
BBFILE_PRIORITY_meta-ros2-autom8 = "6"

LAYERDEPENDS_meta-ros2-autom8 = "core"
LAYERSERIES_COMPAT_meta-ros2-autom8 = "dunfell"
```
